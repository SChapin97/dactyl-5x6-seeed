#include "dactyl_manuform_5x6.dtsi"

&default_transform { // The matrix transform for this board is 6 columns over because the left half is 6 columns wide according to the matrix.
    col-offset = <6>;
};

&kscan0 {
    col-gpios =
        <&gpio0 6 (GPIO_ACTIVE_LOW | GPIO_PULL_DOWN)>,   // Use P0.06 for column 0
        <&gpio0 7 (GPIO_ACTIVE_LOW | GPIO_PULL_DOWN)>,   // Use P0.07 for column 1
        <&gpio0 8 (GPIO_ACTIVE_LOW | GPIO_PULL_DOWN)>,   // Use P0.08 for column 2
        <&gpio0 9 (GPIO_ACTIVE_LOW | GPIO_PULL_DOWN)>,   // Use P0.09 (NFC1) for column 3
        <&gpio0 10 (GPIO_ACTIVE_LOW | GPIO_PULL_DOWN)>,  // Use P0.10 (NFC2) for column 4
        <&gpio0 11 (GPIO_ACTIVE_LOW | GPIO_PULL_DOWN)>;  // Use P0.11 for column 5
};
